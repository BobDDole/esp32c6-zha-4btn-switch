## sdkconfig.defaults
```kconfig
CONFIG_IDF_TARGET="esp32c6"
CONFIG_ESPTOOLPY_FLASHSIZE_4MB=y
CONFIG_ESPTOOLPY_FLASHSIZE="4MB"

CONFIG_PARTITION_TABLE_CUSTOM=y
CONFIG_PARTITION_TABLE_CUSTOM_FILENAME="partitions.csv"

CONFIG_ZB_ENABLED=y
CONFIG_ZB_ZED=y
CONFIG_ZB_RADIO_NATIVE=y
CONFIG_ESP_ZIGBEE_ENABLED=y
CONFIG_ZB_ED_ROLE=y
CONFIG_ZB_USE_OSIF_ESP=y
CONFIG_IEEE802154_ENABLED=y

CONFIG_ESP_MAIN_TASK_STACK_SIZE=8192
```
